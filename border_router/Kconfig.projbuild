## border_router/Kconfig.projbuild
```kconfig
menu "ESP Thread Border Router — Application Layer"

    config APP_NETWORK_ID
        string "Thread network logical name"
        default "HomeNet01"
        help
            Used as a path component in MQTT topics and REST API responses.
            Must match the value configured on all sensor nodes.

    config MQTT_BROKER_URI
        string "MQTT broker URI"
        default "mqtt://192.168.1.10:1883"
        help
            Full MQTT broker URI.  Examples:
              mqtt://192.168.1.10:1883       (plain TCP)
              mqtts://mqtt.example.com:8883  (TLS)
              mqtt://user:pass@192.168.1.10  (auth)

    config MQTT_USERNAME
        string "MQTT username (leave blank if not needed)"
        default ""

    config MQTT_PASSWORD
        string "MQTT password (leave blank if not needed)"
        default ""

    config REST_API_PORT
        int "REST API HTTP port"
        default 8080
        range 1 65535
        help
            Port on which the border router serves its REST API.
            Access via http://<br-ip>:<port>/api/v1/nodes

    config DEVICE_ONLINE_TTL_S
        int "Node online timeout (seconds)"
        default 120
        range 30 3600
        help
            A node is marked offline if no telemetry is received within this
            duration.  Set to at least 2× the sensor reporting interval.

endmenu
```

## gateway/main/Kconfig.projbuild
```kconfig
menu "Gateway Configuration"

    config ZB_RCP_UART_PORT
        int "UART port for RCP"
        range 0 2
        default 1
        help
            UART port used to communicate with the RCP (ESP32-H2).

    config ZB_RCP_UART_TX_PIN
        int "UART TX pin for RCP"
        default 17
        help
            GPIO number for UART TX pin.

    config ZB_RCP_UART_RX_PIN
        int "UART RX pin for RCP"
        default 18
        help
            GPIO number for UART RX pin.

    config ZB_RCP_UART_BAUDRATE
        int "UART baudrate for RCP"
        default 115200
        help
            UART baudrate used for RCP communication.

endmenu
```

## gateway/rcp/sdkconfig.defaults
```kconfig
# Target: ESP32-H2 (802.15.4 RCP)
CONFIG_IDF_TARGET="esp32h2"

# Zigbee RCP
CONFIG_ZB_ENABLED=y
CONFIG_ZB_ZED=y

# UART for RCP (Connect to S3 Host)
CONFIG_ZB_RCP_UART_TX_PIN=17
CONFIG_ZB_RCP_UART_RX_PIN=18
CONFIG_ZB_RCP_UART_PORT=1
CONFIG_ZB_RCP_UART_BAUDRATE=460800

# Partition table
CONFIG_PARTITION_TABLE_CUSTOM=y
CONFIG_PARTITION_TABLE_CUSTOM_FILENAME="partitions.csv"

# Optimization
CONFIG_COMPILER_OPTIMIZATION_SIZE=y

# Log level
CONFIG_LOG_DEFAULT_LEVEL_INFO=y
```

## gateway/sdkconfig.defaults
```kconfig
# AgriNetPro Gateway - sdkconfig.defaults
# Target: ESP32-C6 (native 802.15.4) or ESP32-S3 + ESP32-H2 (RCP)

# Zigbee
CONFIG_ZB_ENABLED=y
CONFIG_ZB_ZCZR=y
CONFIG_ZB_RADIO_NATIVE=y

# Partition table (OTA-ready)
CONFIG_PARTITION_TABLE_CUSTOM=y
CONFIG_PARTITION_TABLE_CUSTOM_FILENAME="partitions.csv"

# Wi-Fi (for cloud connectivity)
CONFIG_ESP_WIFI_ENABLED=y

# Log level
CONFIG_LOG_DEFAULT_LEVEL_INFO=y

# Stack sizes
CONFIG_ESP_MAIN_TASK_STACK_SIZE=4096

# Flash size
CONFIG_ESPTOOLPY_FLASHSIZE_8MB=y
CONFIG_ESPTOOLPY_FLASHSIZE="8MB"
```

## node/sdkconfig.defaults
```kconfig
# AgriNetPro Node - sdkconfig.defaults
# Target: ESP32-H2 (802.15.4 SoC)

# Target Chip
CONFIG_IDF_TARGET="esp32h2"

# Zigbee
CONFIG_ZB_ENABLED=y
CONFIG_ZB_ZED=y
CONFIG_ZB_RADIO_NATIVE=y

# Partition table (OTA-ready)
CONFIG_PARTITION_TABLE_CUSTOM=y
CONFIG_PARTITION_TABLE_CUSTOM_FILENAME="partitions.csv"

# Power Management
CONFIG_PM_ENABLE=y
CONFIG_FREERTOS_USE_TICKLESS_IDLE=y

# Log level (reduce in production)
CONFIG_LOG_DEFAULT_LEVEL_INFO=y

# Stack sizes
CONFIG_ESP_MAIN_TASK_STACK_SIZE=4096

# Flash size
CONFIG_ESPTOOLPY_FLASHSIZE_8MB=y
CONFIG_ESPTOOLPY_FLASHSIZE="8MB"
```

## sensor_node/Kconfig.projbuild
```kconfig
menu "ESP Thread Sensor Node"

    config APP_NODE_LABEL
        string "Node human-readable label"
        default "SensorNode-01"
        help
            Label shown in the border router dashboard and MQTT topics.
            Maximum 15 characters.

    choice APP_SENSOR_TYPE
        prompt "Sensor hardware"
        default APP_SENSOR_TYPE_DHT22
        help
            Select the temperature/humidity sensor fitted to this node.

        config APP_SENSOR_TYPE_DHT22
            bool "DHT22 (AM2302) — 1-wire bit-bang"
        config APP_SENSOR_TYPE_SHT31
            bool "SHT31-D / SHT35 — I2C"
    endchoice

    config APP_SENSOR_DHT22_GPIO
        int "DHT22 data GPIO number"
        depends on APP_SENSOR_TYPE_DHT22
        default 8
        range 0 46
        help
            GPIO pin connected to the DHT22 data line.
            A 10 kΩ pull-up to 3V3 is required.

    config APP_SENSOR_SHT31_SDA
        int "SHT31 I2C SDA GPIO"
        depends on APP_SENSOR_TYPE_SHT31
        default 6

    config APP_SENSOR_SHT31_SCL
        int "SHT31 I2C SCL GPIO"
        depends on APP_SENSOR_TYPE_SHT31
        default 7

    choice APP_SLEEP_MODE
        prompt "Power management / sleep mode"
        default APP_SLEEP_MODE_LIGHT
        help
            Light: Thread stays attached; modem-sleep between reports.
            Deep:  Thread dataset saved to NVS; ESP enters deep-sleep.
                   Lowest power but ~3 s to rejoin on each wake.

        config APP_SLEEP_MODE_LIGHT
            bool "Light sleep (Thread always attached)"
        config APP_SLEEP_MODE_DEEP
            bool "Deep sleep (rejoin on each wake)"
    endchoice

    config APP_SENSOR_REPORT_INTERVAL_S
        int "Sensor reporting interval (seconds)"
        default 30
        range 5 3600
        help
            How often the node reads the sensor and posts to the border router.

    config APP_BATTERY_SENSE_ENABLE
        bool "Enable battery voltage sensing via ADC"
        default n
        help
            Enable if the node runs on a LiPo / battery pack and you want
            battery level reported in telemetry.  Requires a resistor divider
            from battery+ to an ADC-capable GPIO.

    config APP_LED_GPIO
        int "Status LED GPIO number"
        default 2
        range 0 46

    config APP_NETWORK_ID
        string "Thread network identifier (for MQTT topics)"
        default "HomeNet01"
        help
            Logical name of this Thread network.  Must match the border router
            configuration.  Used as path component in MQTT topics.

endmenu
```

## sensor_node/components/app_sensor/Kconfig.projbuild
```kconfig
menu "Sensor Node Application"

    choice APP_SENSOR_TYPE
        prompt "Sensor hardware type"
        default APP_SENSOR_TYPE_DHT22
        help
            Select the physical sensor fitted on this node.

        config APP_SENSOR_TYPE_DHT22
            bool "DHT22 (single-wire bit-bang)"

        config APP_SENSOR_TYPE_SHT31
            bool "SHT31 (I2C)"
    endchoice

    config APP_SENSOR_DHT22_GPIO
        int "DHT22 data GPIO number"
        depends on APP_SENSOR_TYPE_DHT22
        default 8
        help
            GPIO pin connected to the DHT22 data line.

    config APP_SENSOR_REPORT_INTERVAL_S
        int "Sensor report interval (seconds)"
        default 30
        range 5 3600

    config APP_SLEEP_MODE_LIGHT
        bool "Use light sleep (Thread stays attached)"
        default y

    config APP_BATTERY_SENSE_ENABLE
        bool "Enable battery voltage sensing via ADC"
        default n

    config APP_LED_GPIO
        int "LED GPIO number"
        default 2

    config APP_NODE_LABEL
        string "Node label"
        default "SensorNode-01"
        help
            Human-readable label sent during registration.

    config APP_NETWORK_ID
        string "Network ID"
        default "HomeNet01"

endmenu
```
